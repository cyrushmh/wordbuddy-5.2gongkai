## quantum-kernel/arch/quantum/Kconfig.debug
```kconfig
# SPDX-License-Identifier: GPL-2.0
# Quantum architecture debug options (host-emulated).

config QUANTUM_DEBUG_LINK
	bool "Debug the QPU pi-ring link buffer"
	depends on QUANTUM
	default n
	help
	  Extra pr_debug noise for every link push/overwrite, so the
	  CPU<->QPU exchange flow can be audited at runtime.
```

## quantum-kernel/drivers/quantum/Kconfig
```kconfig
# SPDX-License-Identifier: GPL-2.0
#
# Quantum processing unit subsystem (drivers/quantum).
# 注意：QUANTUM_QPU 三态开关定义在 arch/quantum/Kconfig（架构配置域），
# 本文件只登记具体设备实现，避免重复定义。

config QUANTUM_QPU_DEV
	tristate "Emulated QPU device /dev/qpuN"
	default y
	depends on QUANTUM_QPU
	help
	  One misc device per emulated QPU (count from CONFIG_QUANTUM_QPU_NR):
	  /dev/qpu0 exposes QPU_ENC / QPU_DEC / QPU_LINK_STATS / QPU_RESET.

config QUANTUM_NET_DEV
	tristate "Quantum networking device /dev/qnet0"
	default y
	depends on QUANTUM_NET
	help
	  One misc device per emulated quantum-network endpoint:
	  /dev/qnet0 exposes QNET_LINK_ADD / QNET_LINK_DEL / QNET_LINK_STATS /
	  QNET_ENTANGLE_SWAP / QNET_TELEPORT / QNET_RESET.  Feeds the Bell-pair
	  routing table maintained by arch/quantum/kernel/quantum-net.c.
```

## quantum-kernel/drivers/quantum/net/Kconfig
```kconfig
# SPDX-License-Identifier: GPL-2.0
config QUANTUM_NET_DEV
	tristate "Emulated QNIC device /dev/qnet0"
	default y
	depends on QUANTUM_NET
	help
	  One misc device /dev/qnet0 exposing the quantum networking
	  substrate: link add/del, Bell-pair distribution, entanglement
	  swapping and teleportation counters. Built on the
	  arch/quantum mesh orchestration model (quantum-net.c). The
	  QNIC hardware abstraction (qnic.c) auto-negotiates a default
	  mesh on probe.
```
